## kcfg/tags/v1_1_2/Kconfig
```kconfig
#
# KCFG configuration
#
menu "Simple Configuration Utility (KCFG)"

config KCFG
        tristate "Kernel-based configuration (kcfg) support"
        depends on EXPERIMENTAL
        ---help---
          Kcfg is a kernel module that reads a configuration file containing
	  name value pairs. The configuration values can then be queried
	  by other kernel modulues through an exported API.

          To compile this as a module, choose M here: the module
          will be called kcfg.

          If unsure, say N.

config KCFG_FILENAME
	string "Default filename to load."
	default "/etc/kcfg"
	depends on KCFG
	---help---
	  This variable sets the default filename that kcfg will load upon
	  startup. The default filename may be changed by the 'filename' module
	  parameter.

config KCFG_CLI
        bool "Include the config command line interface."
        default false
        depends on KCLI
	depends on KCFG
        ---help---
          This variable will compile in a command line interface that can
	  be used to query configuration values, load new files, etc. The
	  CLI depends on the KCLI kernel module.

endmenu
```

## kcli/trunk/Kconfig
```kconfig
#
# KCLI configuration
#
menu "Command Line Interface (KCLI)"

config KCLI
        tristate "Kernel-based Command Line Interface (kcli) support"
        depends on EXPERIMENTAL
        ---help---
          Kcli is a command line interface that runs in the kernel. It
          is meant for embedded Linux applications where there may not
          be a user space application. Some embedded applications run
          entirely in the kernel, and this module is intended to provide
          a command line interface facility for this case. The current version
          has been designed primarily for device debug and diagnostic
          applications. This version is not secure, thus, it should not
          be enabled for devices that are not on closed networks.

          Kcli is not accessible via user space sockets. If one tries to
          open a socket on the kcli device using a socket call from
          libc, it will return EINVAL. One can telnet to Kcli from
          anywhere, but, it is not a normal user space socket device.

          To compile this as a module, choose M here: the module
          will be called kcli.

          If unsure, say N.

config KCLI_PORT
        int "Port the cli listens on."
        default 23
        depends on KCLI
        ---help---
          This variable defines the port the cli will listen on by default. The
          port may be changed at module load time with the cliPort module
          parameter.

endmenu
```

## kjvm/tags/dev0_1_0/Kconfig
```kconfig
#
# JEM configuration
#
menu "Java Virtual Machine (Jem)"

config JEM
	tristate "Kernel-based Java Virtual Machine (Jem) support"
	depends on EXPERIMENTAL
	---help---
	  Jem is a java virtual machine (JVM) that runs in the kernel. It
	  is intended for embedded java applications. You will also
	  need the java class files that come with the JEM JDK.

	  To compile this as a module, choose M here: the module
	  will be called kjvm.

	  If unsure, say N.

config JEM_CLI
	bool "Enable command line interface"
	depends on JEM
	default false
	---help---
	  Compile in the command line interface (kcli) support. Some of the debug 
	  and statistics gathering aspects register commands with kcli that will
	  display their results.

config JEM_MALLOC_STATS
	bool "Enable malloc statistics"
	depends on JEM_CLI
	default false
	---help---
	  Compile in the malloc statistics aspect, which will keep track of
	  how much memory has been allocated, and what the memory was allocated
	  for. A command is added to the cli to display the statistics. Thus
	  this option depends on adding the cli support.

config JEM_UNIT_TEST
	bool "Enable unit test cases"
	depends on JEM_CLI
	default false
	---help---
	  Compile in the unit test cases.

config JEM_FUNCTION_TRACE
	bool "Enable function tracing for debug"
	depends on JEM_CLI
	default false
	---help---
	  Compile in the function tracing aspect which will printk a message
	  each time a function is entered. The aspect also adds a command that
	  will allow the user to enable and disable tracing at run time.

endmenu
```

## kjvm/trunk/Kconfig
```kconfig
#
# JEM configuration
#
menu "Java Virtual Machine (Jem)"

config JEM
	tristate "Kernel-based Java Virtual Machine (Jem) support"
	depends on EXPERIMENTAL
	---help---
	  Jem is a java virtual machine (JVM) that runs in the kernel. It
	  is intended for embedded java applications. You will also
	  need the java class files that come with the JEM JDK.

	  To compile this as a module, choose M here: the module
	  will be called kjvm.

	  If unsure, say N.

endmenu
```

## ktst/trunk/Kconfig
```kconfig
#
# KTST configuration
#
menu "Module Unit Testing Interface (KTST)"

config KTST
        tristate "Module Unit Testing Interface (ktst) support"
        depends on KCFG
        depends on KCLI
        ---help---
          Ktst is a unit testing interface for kernel modules. It
          is meant for embedded Linux applications where there may not
          be any user space space. Some embedded applications run
          entirely in the kernel, and this module is intended to provide
          a unit testing interface facility for this case. 
          
          Ktst depends on Kcli, which is a kernel command line
          interface. Ktst adds commands to Kcli to run test cases.
          
          Ktst also depends on Kcfg, which it uses to load it's internal
          configuration parameters.

          To compile this as a module, choose M here: the module
          will be called ktst.

          If unsure, say N.

endmenu
```
